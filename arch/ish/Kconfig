## arch/ish/Kconfig
```kconfig
config ISH
	def_bool y
	select GENERIC_ATOMIC64
	select GENERIC_IRQ_SHOW
	select THREAD_INFO_IN_TASK
	select HAVE_FUTEX_CMPXCHG
	select VMALLOC_BROKEN
	select HAVE_COPY_THREAD_TLS
	select SYSCTL_EXCEPTION_TRACE
	select GENERIC_SCHED_CLOCK
	select GENERIC_CPU_DEVICES
	select GENERIC_CLOCKEVENTS

config ISH_MAIN
	bool
	default y

config ISH_EMULATOR
	string
	default ishemu

config ARCH_RANDOM
	def_bool y
	prompt "Host random number generator" if EXPERT

# ABI vore
config 64BIT
	bool
	default y
config COMPAT
	def_bool y
config IA32_EMULATION
	def_bool y
config SYSVIPC_COMPAT
	def_bool y
	depends on SYSVIPC

config MMU
	bool
	default y

config HZ
	int "HZ"
	default 100

config PGTABLE_LEVELS
	int
	default 3

config NO_DMA
	def_bool y
config NO_IOMEM
	def_bool y
config NO_VMALLOC
	def_bool y
config GENERIC_HWEIGHT
	def_bool y
config GENERIC_CSUM
	def_bool y

config HOSTFS
	bool "Host filesystem"

config HOST_INET
	bool "Host-based AF_INET"
	default y
	depends on NET && !INET

config GOLP
	bool "Golp interface"
	default y
	depends on INET
```
